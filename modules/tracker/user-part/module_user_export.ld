/* Dynalib table locations */
PROVIDE (link_dynalib_location_user = platform_user_part_dynalib_table_flash_start + 0);
PROVIDE (link_dynalib_location_user_compat = platform_user_part_compat_dynalib_table_flash_start + 0 );
