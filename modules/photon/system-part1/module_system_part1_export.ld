/* Dynalib table locations */
PROVIDE (link_dynalib_location_communication            = platform_system_part1_dynalib_table_flash_start + 0);
PROVIDE (link_dynalib_location_wifi_resource            = platform_system_part1_dynalib_table_flash_start + 4);
PROVIDE (link_dynalib_location_system_module_part1      = platform_system_part1_dynalib_table_flash_start + 8);
PROVIDE (link_dynalib_location_services                 = platform_system_part1_dynalib_table_flash_start + 12);
PROVIDE (link_dynalib_location_crypto                   = platform_system_part1_dynalib_table_flash_start + 16);
