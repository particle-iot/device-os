/* Dynalib table locations */
PROVIDE (link_dynalib_location_offset_hal                  = 0);
PROVIDE (link_dynalib_location_offset_rt                   = 4);
PROVIDE (link_dynalib_location_offset_system               = 8);
PROVIDE (link_dynalib_location_offset_hal_peripherals      = 12);
PROVIDE (link_dynalib_location_offset_hal_i2c              = 16);
PROVIDE (link_dynalib_location_offset_hal_gpio             = 20);
PROVIDE (link_dynalib_location_offset_hal_spi              = 24);
PROVIDE (link_dynalib_location_offset_hal_core             = 28);
PROVIDE (link_dynalib_location_offset_hal_socket           = 32);
PROVIDE (link_dynalib_location_offset_hal_usart            = 36);
PROVIDE (link_dynalib_location_offset_system_net           = 40);
PROVIDE (link_dynalib_location_offset_system_cloud         = 44);
PROVIDE (link_dynalib_location_offset_hal_concurrent       = 48);
PROVIDE (link_dynalib_location_offset_hal_usb              = 52);
PROVIDE (link_dynalib_location_offset_hal_rgbled           = 56);
PROVIDE (link_dynalib_location_offset_hal_bootloader       = 60);
PROVIDE (link_dynalib_location_offset_hal_dct              = 64);
PROVIDE (link_dynalib_location_offset_communication        = 68);
PROVIDE (link_dynalib_location_offset_services             = 72);
PROVIDE (link_dynalib_location_offset_hal_inet             = 76);
PROVIDE (link_dynalib_location_offset_hal_netdb            = 80);
PROVIDE (link_dynalib_location_offset_hal_ifapi            = 84);
PROVIDE (link_dynalib_location_offset_hal_resolvapi        = 88);
PROVIDE (link_dynalib_location_offset_hal_wlan             = 92);
PROVIDE (link_dynalib_location_offset_hal_ble              = 96);
PROVIDE (link_dynalib_location_offset_hal_posix_syscall    = 100);
PROVIDE (link_dynalib_location_offset_hal_storage          = 104);
PROVIDE (link_dynalib_location_offset_hal_watchdog         = 108);
PROVIDE (link_dynalib_location_offset_hal_backup_ram       = 112);
PROVIDE (link_dynalib_location_offset_system_asset_manager = 116);