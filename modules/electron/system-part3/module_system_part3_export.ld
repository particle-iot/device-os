/* Dynalib table locations */
PROVIDE (link_dynalib_location_system_module_part3      = platform_system_part3_dynalib_table_flash_start + 0);
PROVIDE (link_dynalib_location_hal_usb                  = platform_system_part3_dynalib_table_flash_start + 4);
PROVIDE (link_dynalib_location_hal_cellular             = platform_system_part3_dynalib_table_flash_start + 8);
PROVIDE (link_dynalib_location_hal_socket               = platform_system_part3_dynalib_table_flash_start + 12);
PROVIDE (link_dynalib_location_hal_bootloader           = platform_system_part3_dynalib_table_flash_start + 16);
PROVIDE (link_dynalib_location_services2                = platform_system_part3_dynalib_table_flash_start + 20);
