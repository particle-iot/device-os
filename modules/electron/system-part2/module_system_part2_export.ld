dynamic_reset_handler_location = _system_part2_vector_table_flash_start + 4;

PROVIDE ( dynalib_location_hal                  = _system_part2_dynalib_table_flash_start + 0 );
PROVIDE ( dynalib_location_rt                   = _system_part2_dynalib_table_flash_start + 4 );
PROVIDE ( dynalib_location_system               = _system_part2_dynalib_table_flash_start + 8 );
PROVIDE ( dynalib_location_hal_peripherals      = _system_part2_dynalib_table_flash_start + 12 );
PROVIDE ( dynalib_location_hal_i2c              = _system_part2_dynalib_table_flash_start + 16 );
PROVIDE ( dynalib_location_hal_gpio             = _system_part2_dynalib_table_flash_start + 20 );
PROVIDE ( dynalib_location_hal_spi              = _system_part2_dynalib_table_flash_start + 24 );
PROVIDE ( dynalib_location_hal_core             = _system_part2_dynalib_table_flash_start + 28 );
PROVIDE ( dynalib_location_hal_socket           = _system_part2_dynalib_table_flash_start + 32 );
PROVIDE ( dynalib_location_hal_cellular         = _system_part2_dynalib_table_flash_start + 36 );
PROVIDE ( dynalib_location_hal_usart            = _system_part2_dynalib_table_flash_start + 40 );
PROVIDE ( dynalib_location_system_net           = _system_part2_dynalib_table_flash_start + 44 );
PROVIDE ( dynalib_location_system_cloud         = _system_part2_dynalib_table_flash_start + 48 );
PROVIDE ( dynalib_location_hal_concurrent       = _system_part2_dynalib_table_flash_start + 52 );
PROVIDE ( dynalib_location_hal_can              = _system_part2_dynalib_table_flash_start + 56 );
PROVIDE ( dynalib_location_hal_rgbled           = _system_part2_dynalib_table_flash_start + 60 );
PROVIDE ( dynalib_location_hal_dct              = _system_part2_dynalib_table_flash_start + 64 );
