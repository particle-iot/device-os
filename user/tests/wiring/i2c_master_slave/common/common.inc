#include "random.h"

#ifndef TEST_I2C_BUFFER_SIZE
#define TEST_I2C_BUFFER_SIZE (I2C_BUFFER_LENGTH)
#else

hal_i2c_config_t USE_ACQUIRE_WIRE_BUFFER() {
#if TEST_I2C_BUFFER_SIZE != 0
    hal_i2c_config_t config = {
		.size = sizeof(hal_i2c_config_t),
		.version = HAL_I2C_CONFIG_VERSION_1,
		.rx_buffer = new (std::nothrow) uint8_t[TEST_I2C_BUFFER_SIZE],
		.rx_buffer_size = TEST_I2C_BUFFER_SIZE,
		.tx_buffer = new (std::nothrow) uint8_t[TEST_I2C_BUFFER_SIZE],
		.tx_buffer_size = TEST_I2C_BUFFER_SIZE
	};
#else
# undef TEST_I2C_BUFFER_SIZE
# define TEST_I2C_BUFFER_SIZE (I2C_BUFFER_LENGTH)
    // Compatibility mode, where the buffers should be generated by HAL
    hal_i2c_config_t config = {
        .size = sizeof(hal_i2c_config_t),
        .version = HAL_I2C_CONFIG_VERSION_1
    };
#endif // TEST_I2C_BUFFER_SIZE != 0

	return config;
}

#endif // TEST_I2C_BUFFER_SIZE

#define TRANSFER_LENGTH_1 (TEST_I2C_BUFFER_SIZE)
#define TRANSFER_LENGTH_2 (TEST_I2C_BUFFER_SIZE)

#define BASE_SEED (20200101)
#define MASTER_TEST_MESSAGE_SEED (BASE_SEED + 1)
#define SLAVE_TEST_MESSAGE_SEED (BASE_SEED + 2)

#define I2C_DELAY 0
#define I2C_ADDRESS 0x32

namespace {

// I2C_06: the slave masks its interrupts, the master sends write transactions with a
// changing rest between them
constexpr uint8_t STALL_HEADER_SIZE = 3;
constexpr uint8_t STALL_TRANSFER_SIZE = 32;
constexpr uint32_t STALL_MASK_US = 1800;
constexpr uint32_t STALL_TRAFFIC_LIMIT_MS = 5000;
constexpr uint32_t STALL_MAX_GAP_US = 100;
constexpr uint32_t STALL_TRANSFERS = 3000;
constexpr uint32_t STALL_READ_TRANSFERS = 100;
constexpr uint32_t STALL_LOOP_LIMIT_MS = 120 * 1000;
// The stall frames: STALL_FRAME_SEED, 16-bit big-endian sequence number, padding.
constexpr uint8_t STALL_FRAME_SEED = 0xa5;
constexpr uint8_t STALL_FRAME_PADDING = 0x5a;
constexpr uint16_t STALL_STOP_SEQ = 0xffff;
constexpr uint8_t STALL_READ_SEED = 0xa7;
constexpr uint8_t STALL_RESTARTED_READ_SEED = 0xa8;
constexpr uint8_t STALL_STOP_READ_SEED = 0xa9;
constexpr uint32_t STALL_REPLY_TRANSFERS = 100;
constexpr uint32_t STALL_REPLY_TIMEOUT_MS = 500;

inline void stallFrame(uint8_t* buf, uint8_t seed, uint16_t seq) {
    buf[0] = seed;
    buf[1] = (uint8_t)(seq >> 8);
    buf[2] = (uint8_t)seq;
    memset(buf + STALL_HEADER_SIZE, STALL_FRAME_PADDING, STALL_TRANSFER_SIZE - STALL_HEADER_SIZE);
}

inline uint16_t stallFrameSeq(const uint8_t* buf) {
    return ((uint16_t)buf[1] << 8) | buf[2];
}

inline bool stallFrameValid(const uint8_t* buf, uint8_t seed) {
    if (buf[0] != seed) {
        return false;
    }
    for (size_t i = STALL_HEADER_SIZE; i < STALL_TRANSFER_SIZE; i++) {
        if (buf[i] != STALL_FRAME_PADDING) {
            return false;
        }
    }
    return true;
}

inline void stallDelayUs(uint32_t us) {
    const uint32_t start = micros();
    while ((micros() - start) < us) {
    }
}

} // anonymous namespace

static uint8_t I2C_Test_Tx_Buffer[TEST_I2C_BUFFER_SIZE + 1];
static uint8_t I2C_Test_Rx_Buffer[TEST_I2C_BUFFER_SIZE + 1];
static char MASTER_TEST_MESSAGE[TEST_I2C_BUFFER_SIZE - sizeof(uint32_t)] = {};
static char SLAVE_TEST_MESSAGE[TEST_I2C_BUFFER_SIZE] = {};

STARTUP({
    Random rMaster(MASTER_TEST_MESSAGE_SEED);
    Random rSlave(SLAVE_TEST_MESSAGE_SEED);

    rMaster.genBase32(MASTER_TEST_MESSAGE, sizeof(MASTER_TEST_MESSAGE) - 1);
    rSlave.genBase32(SLAVE_TEST_MESSAGE, sizeof(SLAVE_TEST_MESSAGE) - 1);
});
